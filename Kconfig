## Kconfig
```kconfig
DT_COMPAT_ZMK_ROLLING_COMBOS := zmk,rolling-combos

config ZMK_ROLLING_COMBOS
    bool
    default y
    depends on $(dt_compat_enabled,$(DT_COMPAT_ZMK_ROLLING_COMBOS))

if ZMK_ROLLING_COMBOS

config ZMK_ROLLING_COMBOS_MAX_PRESSED_COMBOS
    int "Maximum number of simultaneously active (held) rolling combos"
    default 4

config ZMK_ROLLING_COMBOS_MAX_DETECTION_CONTEXTS
    int "Maximum number of concurrent combo detection slots"
    default 3

endif # ZMK_ROLLING_COMBOS
```

## dts/bindings/zmk,rolling-combos.yaml
```yaml
description: Rolling Combos - combos with support for rolling (overlapping) activation

compatible: "zmk,rolling-combos"

child-binding:
  description: "A rolling combo"

  properties:
    bindings:
      type: phandle-array
      required: true
    key-positions:
      type: array
      required: true
    timeout-ms:
      type: int
      default: 50
    require-prior-idle-ms:
      type: int
      default: -1
    slow-release:
      type: boolean
    layers:
      type: array
```
